## boards/shields/tws_lp_jis60/Kconfig.defconfig
```kconfig
if SHIELD_TWS_LP_JIS60_RIGHT

# Name must be less than 16 characters long!
config ZMK_KEYBOARD_NAME
    default "tws_lp_jis60"

config ZMK_SPLIT_ROLE_CENTRAL
    default n

config USB_DEVICE_PRODUCT
    default "tws_lp_jis60_Right"

config BT_DEVICE_NAME
    default "tws_lp_jis60_Right"

endif

if SHIELD_TWS_LP_JIS60_LEFT

# Name must be less than 16 characters long!
config ZMK_KEYBOARD_NAME
    default "tws_lp_jis60"

config ZMK_SPLIT_ROLE_CENTRAL
    default y

config USB_DEVICE_PRODUCT
    default "tws_lp_jis60_Left"

config BT_DEVICE_NAME
    default "tws_lp_jis60_Left"

endif

if SHIELD_TWS_LP_JIS60_LEFT || SHIELD_TWS_LP_JIS60_RIGHT

config ZMK_SPLIT
    default y

endif
```

## config/west.yml
```yaml
manifest:
  defaults:
    revision: v0.3
  remotes:
    - name: zmkfirmware
      url-base: https://github.com/zmkfirmware
    - name: caksoylar
      url-base: https://github.com/caksoylar
    # Additional modules containing boards/shields/custom code can be listed here as well
    # See https://docs.zephyrproject.org/3.2.0/develop/west/manifest.html#projects
  projects:
    - name: zmk
      remote: zmkfirmware
      import: app/west.yml
    - name: zmk-rgbled-widget
      remote: caksoylar
      revision: v0.3
  self:
    path: config
```
