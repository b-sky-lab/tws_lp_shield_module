#include "tws_lp_jis60.dtsi"

&kscan0 {
    gpios
        = <&xiao_d 1 (GPIO_ACTIVE_HIGH)>
        , <&xiao_d 2 (GPIO_ACTIVE_HIGH)>
        , <&xiao_d 3 (GPIO_ACTIVE_HIGH)>
        , <&xiao_d 4 (GPIO_ACTIVE_HIGH)>
        , <&xiao_d 5 (GPIO_ACTIVE_HIGH)>
        , <&xiao_d 6 (GPIO_ACTIVE_HIGH)>
        , <&xiao_d 7 (GPIO_ACTIVE_HIGH)>
        ;
};
